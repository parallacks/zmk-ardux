## config/boards/shields/scottofrog/Kconfig.defconfig
```kconfig
if SHIELD_CORNE_ARDUX_LEFT || SHIELD_CORNE_ARDUX_LEFT_BIG

config ZMK_KEYBOARD_NAME
	default "ARDUX L"

endif
```

## config/boards/shields/scottofrog/Kconfig.shield
```kconfig
# Copyright (c) 2021 Mike "KemoNine" Crosson
# SPDX-License-Identifier: MIT

config SHIELD_SCOTTOFROG_ARDUX_LEFT
	def_bool $(shields_list_contains,scottofrog_ardux_left)

config SHIELD_SCOTTOFROG_ARDUX_LEFT_BIG
	def_bool $(shields_list_contains,scottofrog_ardux_left_big)
```
